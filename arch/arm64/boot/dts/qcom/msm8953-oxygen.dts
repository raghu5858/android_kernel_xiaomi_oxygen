/*
 * Copyright (c) 2015-2016, The Linux Foundation. All rights reserved.
 * Copyright (C) 2017 XiaoMi, Inc.
 *
 * This program is free software; you can redistribute it and/or modify
 * it under the terms of the GNU General Public License version 2 and
 * only version 2 as published by the Free Software Foundation.
 *
 * This program is distributed in the hope that it will be useful,
 * but WITHOUT ANY WARRANTY; without even the implied warranty of
 * MERCHANTABILITY or FITNESS FOR A PARTICULAR PURPOSE.  See the
 * GNU General Public License for more details.
 */

/dts-v1/;

#include "msm8953.dtsi"
#include "msm8953-mdss-panels.dtsi"
#include "pmi8950.dtsi"
#include "msm8953-mtp.dtsi"
#include "msm8953-pmi8950.dtsi"
#include "oxygen/msm8953-oxygen.dtsi"

/ {
        model = "Qualcomm Technologies, Inc. MSM8953 MTP";
        compatible = "qcom,msm8953-mtp", "qcom,msm8953", "qcom,mtp";
        qcom,board-id= <8 0>;
        qcom,pmic-id = <0x010016 0x010011 0x0 0x0>;
};

&qpnp_fg {
        qcom,battery-data = <&mtp_batterydata>;
        qcom,resume-soc-raw = <253>;
        qcom,fg-cutoff-voltage-mv = <3400>;
        qcom,thermal-coefficients = [DA 86 F0 50 08 3C];
        qcom,vbat-estimate-diff-mv = <200>;
        qcom,warm-bat-decidegc = <450>;
        qcom,cool-bat-decidegc = <150>;
        qcom,hot-bat-decidegc  = <600>;
        qcom,cold-bat-decidegc = <0>;
        qcom,ext-sense-type;
};

&qpnp_smbcharger {
        qcom,battery-data = <&mtp_batterydata>;
        qcom,chg-led-sw-controls;
        qcom,chg-led-support;
        qcom,external-typec;
        qcom,typec-psy-name = "typec";
        qcom,fastchg-current-ma = <3400>;
        qcom,float-voltage-mv = <4400>;
        qcom,thermal-mitigation = <2500 2000 1500 1000>;
        qcom,thermal-mitigation-screen-off = <3000 2800 2500 2000 1600 1200 1000 500>;
        qcom,thermal-mitigation-screen-on = <2000 1400 1100 900 700 650 600 500>;
        qcom,thermal-mitigation-hvdcp-screen-off = <1800 1600 1400 1200 1000 900 700 500>;
        qcom,thermal-mitigation-hvdcp-screen-on = <1200 900 700 600 550 500 500 500>;
        qcom,thermal-fcc-screen-off = <3400 3200 2800 2400 1600 1200 1000 500>;
        qcom,thermal-fcc-screen-on = <1800 1100 1000 900 700 500 300 500>;
        qcom,fastchg-current-comp = <1200>;
        qcom,float-voltage-comp = <16>;
        qcom,override-usb-current;
        /delete-property/ qcom,autoadjust-vfloat;
};
